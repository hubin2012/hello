/*
* ADC采样
*/
#include <stc12c5a60s2.h>
#include <intrins.h>

//10K  温度传感器表
//温度-电阻值转换表,下标表示温度,下标0对应-40度,1对应-39度...,阻值单位为欧
//如果阻值大于R_T_Table[0]则温度小-40度，阻值大于R_T_Table[1]则温度小于-39度...
code const long R_T_Table[221] =
    {
        335811, 314029, 293803, 275015, 257552,     //-40~-36
        241313, 226204, 212141, 199044, 186841,     //-35~-31
        175465, 164856, 154957, 145716, 137086,     //-30~-26
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        89,                                         //180
    };    


/*********************************************************************************************
函数名：adcGet
作  用: 获得ADC转换值
参  数：转换通道
返回值：16bit 温度值
**********************************************************************************************/
static unsigned int adcGet(unsigned char channel)
{
	ADC_CONTR = 0x88|channel;    //开启AD转换1000 1000 即POWER SPEED1 SPEED0 ADC_FLAG   ADC_START CHS2 CHS1 CHS0 

	//要经过4个CPU时钟的延时，其值才能够保证被设置进ADC_CONTR 寄存器
	_nop_();
	_nop_(); 
	_nop_(); 
	_nop_();

	//等待转换完成
	while(!(ADC_CONTR&0x10))    
	{
	}
	
	ADC_CONTR &= 0xe7;      //关闭AD转换，ADC_FLAG位由软件清0
	
	return (ADC_RES*4+ADC_RESL);   //返回AD转换完成的10位数据(16进制)
}

/*********************************************************************************************
函数名：adcWork
作  用: 转换结果求平均
参  数：转换通道
返回值：转换结果
**********************************************************************************************/
float adcWork(unsigned char channel)
{
	float AD_val;     //定义处理后的数值AD_val为浮点数
	unsigned char i;
	
	for(i=0;i<100;i++) 
	{
		//转换100次求平均值(提高精度)
		AD_val+=adcGet(channel); 
	}
	
	AD_val/=100;
	AD_val=(AD_val*5)/1024; //AD的参考电压是单片机上的5v，所以乘5即为实际电压值
	
	return AD_val;
}

/*********************************************************************************************
函数名：adcWork
作  用: 转换结果求平均
参  数：转换通道
返回值：转换结果
**********************************************************************************************/
extern void delayMS(unsigned int tim);
void adcInit(void)
{
	P1ASF=0x43; //  0100 0011  P1.6  P1.1 P1.0作为AD
	
	ADC_RES=0;   //清零转换结果寄存器高8位
	ADC_RESL=0; //清零转换结果寄存器低2位
	ADC_CONTR=0x80;//开启AD电源
	
	delayMS(2);   //等待1ms，让AD电源稳定
}


/*********************************************************************************************
函数名：tempCalculate
作  用: 温度计算
参  数：转换通道
返回值：转换结果
**********************************************************************************************/
int tempCalculate(unsigned char channel)
{
	float tmp;
	long res; // 阻值
	int left = 0, middle, right = sizeof(R_T_Table)/sizeof(R_T_Table[0]); 

	tmp = adcWork(channel);

	if((unsigned char)tmp == 5)
	{
		tmp = 5.0;
	}

	//有adc采集的电压计算电阻值
	res = (long)((tmp*10000) /(5 - tmp));

	//二分查找
	middle = (left + right)/2;
	while(left < right)
	{
		if(res == R_T_Table[middle])
		{
			break;
		}
		else if(res < R_T_Table[middle])
		{
			left = middle + 1;
		}
		else
		{
			right = middle;
		}

		middle = (left + right) / 2;
	}

	return (middle - 40);
	
}