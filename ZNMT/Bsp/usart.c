/*
*  串口通讯程序
*  作用:打印调试信息，方便程序编写
*/

#include <STC12C5A60S2.h>	//STC12C5AxxS2系列单片机头文件
#include "usart.h"

/*********************************************************************************************
函数名：UART串口初始化函数
调  用：UART_init();
参  数：无
返回值：无
结  果：启动UART串口接收中断，允许串口接收，启动T/C1产生波特率（占用）
备  注：振荡晶体为11.0592MHz，PC串口端设置 [ 19200，8，无，1，无 ]
**********************************************************************************************/
void UART_init (void)
{
	//串口接收中断及波特率发生器， 波特率9600
	SCON = 0x50; //串口工作方式1，允许串口接收（SCON = 0x40 时禁止串口接收）
	PCON = 0x00; //波特率不加倍
	BRT = 0xfd; //设置波特率发生器溢出率

	ES = 1; //开串口中断

	//AUXR |= 0x04; // 独立波特率发生器工作在1T模式
	AUXR |= 0x01; //选择独立波特率发生器作为串口1的波特率
	AUXR |= 0x10; //允许独立波特率发生器运行
}

/*********************************************************************************************
函数名：UART_Send_Char
作  用：发送一个字节数据
参  数：需要UART串口发送的数据（8位/1字节）
返回值：无 
结  果：将参数中的数据发送给UART串口，确认发送完成后退出
备  注：
**********************************************************************************************/
void UART_Send_Char (unsigned char UART_data)
{
	//定义串口发送数据变量
	SBUF = UART_data;	//将接收的数据发送回去

	//检查发送中断标志位
	while(TI == 0)		
	{
	}
	
	TI = 0;			//令发送中断标志位为0（软件清零）
}


/*********************************************************************************************
函数名：UART_Send_String
作  用：
参  数：需要UART串口发送的数据（8位/1字节）
返回值：无 
结  果：向串口发送一个字符串,长度不限。
备  注：例：UART_Send_Char("d9887321$"); 此函数需要#include <string.h>头文件支持。
**********************************************************************************************/
void UART_Send_String (unsigned char *str)
{
	while(*str != '\0')
	{
		UART_Send_Char(*str);
		*str++;
	}
	
	*str = 0;
}


/*********************************************************************************************
函数名：UART串口接收中断处理函数
调  用：[SBUF收到数据后中断处理]
参  数：无
返回值：无
结  果：UART串口接收到数据时产生中断，用户对数据进行处理（并发送回去）
备  注：过长的处理程序会影响后面数据的接收
**********************************************************************************************/
void UART_Receive(void) interrupt 4  
{
	//切换寄存器组到1
	unsigned char UART_data; //定义串口接收数据变量
	
	if (RI == 1)
	{		
		//接收中断标志位为1时
		UART_data = SBUF;	//接收数据 SBUF 为单片机的接收发送缓冲寄存器
		RI = 0;			//令接收中断标志位为0（软件清零）

		//用户函数内容（用户可使用UART_data做数据处理）

		//SBUF = UART_data;	//将接收的数据发送回去（删除//即生效）
		//while(TI == 0);	//检查发送中断标志位
		//TI = 0;		//令发送中断标志位为0（软件清零）
	}

}	



